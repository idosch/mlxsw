## Documentation/devicetree/bindings/net/socionext-netsec.txt
```
* Socionext NetSec Ethernet Controller IP

Required properties:
- compatible: Should be "socionext,synquacer-netsec"
- reg: Address and length of the control register area, followed by the
       address and length of the EEPROM holding the MAC address and
       microengine firmware
- interrupts: Should contain ethernet controller interrupt
- clocks: phandle to the PHY reference clock, and any other clocks to be
          switched by runtime_pm
- clock-names: Required only if more than a single clock is listed in 'clocks'.
               The PHY reference clock must be named 'phy_refclk'
- phy-mode: See ethernet.txt file in the same directory
- phy-handle: phandle to select child phy

Optional properties: (See ethernet.txt file in the same directory)
- local-mac-address
- mac-address
- max-speed
- max-frame-size

Required properties for the child phy:
- reg: phy address

Example:
	eth0: netsec@522D0000 {
		compatible = "socionext,synquacer-netsec";
		reg = <0 0x522D0000 0x0 0x10000>, <0 0x10000000 0x0 0x10000>;
		interrupts = <GIC_SPI 176 IRQ_TYPE_LEVEL_HIGH>;
		clocks = <&clk_netsec>;
		phy-mode = "rgmii";
		max-speed = <1000>;
		max-frame-size = <9000>;
		phy-handle = <&ethphy0>;

		#address-cells = <1>;
		#size-cells = <0>;

		ethphy0: ethernet-phy@1 {
			compatible = "ethernet-phy-ieee802.3-c22";
			reg = <1>;
		};
	};
```
